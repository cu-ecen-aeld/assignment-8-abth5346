## base_external/package/aesdchar_driver/Config.in
```kconfig
config BR2_PACKAGE_AESDCHAR_DRIVER
	bool "aesdchar_driver"
	help
	  Includes the ldd modules from misc-modules and scull
```

## base_external/package/ldd/Config.in
```kconfig
config BR2_PACKAGE_LDD
	bool "ldd"
	help
	  Includes the ldd modules from misc-modules and scull
```
